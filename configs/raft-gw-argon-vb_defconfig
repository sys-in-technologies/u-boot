## configs/raft-gw-argon-vb_defconfig
```kconfig
CONFIG_ARM=y
CONFIG_ARCH_SUNXI=y
CONFIG_SYS_MALLOC_LEN=0x1000000
CONFIG_SYS_MALLOC_F_LEN=0x1000000
CONFIG_DEFAULT_DEVICE_TREE="allwinner/sun8i-t113s-raft-gw-argon-vb"
CONFIG_SPL_SYS_MALLOC_F_LEN=0x2000
CONFIG_SPL=y
CONFIG_MACH_SUN8I_R528=y
CONFIG_DRAM_CLK=792
CONFIG_DRAM_ZQ=8092667
CONFIG_SUNXI_MINIMUM_DRAM_MB=128
# CONFIG_SYS_MALLOC_CLEAR_ON_INIT is not set
# CONFIG_ANDROID_BOOT_IMAGE is not set
CONFIG_BOOTDELAY=13
CONFIG_LOGLEVEL=3
# CONFIG_SYS_DEVICE_NULLDEV is not set
CONFIG_CMD_USB_MASS_STORAGE=y
CONFIG_CMD_UMS_ABORT_KEYED=y
CONFIG_CMD_WDT=y
CONFIG_ENV_FAT_DEVICE_AND_PART=":3"
CONFIG_USE_DEFAULT_ENV_FILE=y
CONFIG_DEFAULT_ENV_FILE="./uboot.env"
CONFIG_PROT_UDP=y
# CONFIG_BOOTDEV_ETH is not set
CONFIG_NET_RANDOM_ETHADDR=y
CONFIG_USE_GATEWAYIP=y
CONFIG_GATEWAYIP="192.168.1.1"
CONFIG_USE_IPADDR=y
CONFIG_IPADDR="192.168.1.39"
CONFIG_USE_NETMASK=y
CONFIG_NETMASK="255.255.255.0"
CONFIG_VIDEO=y
CONFIG_SUNXI_DE2=y
CONFIG_VIDEO_DE2=y
CONFIG_VIDEO_MIPI_DSI=y
CONFIG_VIDEO_SUNXI_MIPI_DSI=y
CONFIG_VIDEO_LCD_SSD2828=y
CONFIG_VIDEO_LCD_SSD2828_TX_CLK=24
CONFIG_VIDEO_LCD_SSD2828_RESET="PH5"
CONFIG_VIDEO_LCD_SPI_CS="PH2"
CONFIG_VIDEO_LCD_SPI_SCLK="PH3"
CONFIG_VIDEO_LCD_SPI_MOSI="PH4"
CONFIG_USE_SERVERIP=y
CONFIG_SERVERIP="192.168.1.101"
CONFIG_PROT_TCP=y
CONFIG_PROT_TCP_SACK=y
CONFIG_FASTBOOT_CMD_OEM_FORMAT=y
CONFIG_FASTBOOT_OEM_RUN=y
CONFIG_FASTBOOT_OEM_BOARD=y
CONFIG_MMC_BROKEN_CD=y
CONFIG_MTD=y
CONFIG_DM_MTD=y
CONFIG_MTD_CONCAT=y
CONFIG_SYS_MTDPARTS_RUNTIME=y
CONFIG_PHY_ADDR=0
CONFIG_PHY_MOTORCOMM=y
CONFIG_SUN8I_EMAC=y
CONFIG_DRAM_SUNXI_ODT_EN=0
CONFIG_DRAM_SUNXI_TPR0=0x004a2195
CONFIG_DRAM_SUNXI_TPR11=0x340000
CONFIG_DRAM_SUNXI_TPR12=0x46
CONFIG_DRAM_SUNXI_TPR13=0x34000100
CONFIG_SPMI=y
CONFIG_SYSINFO=y
CONFIG_USB_EHCI_HCD=y
CONFIG_USB_OHCI_HCD=y
CONFIG_USB_MUSB_GADGET=y
CONFIG_USB_GADGET_OS_DESCRIPTORS=y
# CONFIG_USB_ETHER is not set
# CONFIG_WATCHDOG is not set
CONFIG_CIRCBUF=y
```
